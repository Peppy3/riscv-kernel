## kernel.its
```
/dts-v1/;

/ {
description = "Unknown kernel FIT image";
#address-cells = <1>;

images {

	kernel-1 {
		description = "kernel";
		data = /incbin/("kernel.bin");
		type = "kernel";
		os = "linux";
		arch = "riscv";
		compression = "none";
		load = <0x84000000>;
		entry = <0x84000000>;
	};

	fdt-1 {
		description = "Flattened Device Tree blob";
		data = /incbin/("target.dtb");
		type = "flat_dt";
		arch = "riscv";
		compression = "none";
	};
};

configurations {
        default = "conf-1";
        conf-1 {
			description = "kernel fit";
			kernel = "kernel-1";
			fdt = "fdt-1";
        };
};
};
```
